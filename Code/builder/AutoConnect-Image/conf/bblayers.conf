## Code/builder/AutoConnect-Image/conf/bblayers.conf
```bitbake
# POKY_BBLAYERS_CONF_VERSION is increased each time build/conf/bblayers.conf
# changes incompatibly
POKY_BBLAYERS_CONF_VERSION = "2"

BBPATH = "${TOPDIR}"
BBFILES ?= ""

BBLAYERS ?= " \
  ${TOPDIR}/../poky/meta-poky \
  ${TOPDIR}/../poky/meta-yocto-bsp \
  ${TOPDIR}/../poky/meta \ 
  ${TOPDIR}/../recipes/meta-96boards \ 
  ${TOPDIR}/../recipes/meta-openembedded/meta-oe \
  ${TOPDIR}/../recipes/meta-openembedded/meta-python \
  ${TOPDIR}/../recipes/meta-openembedded/meta-networking \
  ${TOPDIR}/../recipes/meta-openembedded/meta-filesystems \
  ${TOPDIR}/../recipes/meta-raspberrypi \
  ${TOPDIR}/../recipes/meta-java \
  ${TOPDIR}/../recipes/meta-qt5 "
```

## Code/builder/build/conf/bblayers.conf
```bitbake
# POKY_BBLAYERS_CONF_VERSION is increased each time build/conf/bblayers.conf
# changes incompatibly
POKY_BBLAYERS_CONF_VERSION = "2"

BBPATH = "${TOPDIR}"
BBFILES ?= ""

BBLAYERS ?= " \
  ../../builder/poky/meta \
  ../../builder/poky/meta-poky \
  ../../builder/poky/meta-yocto-bsp \
  ../recipes/meta-openembedded/meta-oe \
  ../recipes/meta-openembedded/meta-python \
  ../recipes/meta-openembedded/meta-networking \
  ../recipes/meta-openembedded/meta-filesystems \
  ../recipes/meta-raspberrypi \
  ../recipes/meta-qt5 "
```

## Code/builder/recipes/meta-autoconnect/conf/layer.conf
```bitbake
# We have a conf and classes directory, append to BBPATH
BBPATH .= ":${LAYERDIR}"

# We have a recipes directory, add to BBFILES
BBFILES += "${LAYERDIR}/recipes*/*/*.bb ${LAYERDIR}/recipes*/*/*.bbappend ${LAYERDIR}/recipes*/*.bb"

BBFILE_COLLECTIONS += "meta-autoconnect"
BBFILE_PATTERN_meta-autoconnect := "^${LAYERDIR}/"
BBFILE_PRIORITY_meta-autoconnect = "10"
LAYERSERIES_COMPAT_meta-autoconnect = "kirkstone"
LAYERDEPENDS_meta-autoconnect += "openembedded-layer"

LICENSE_PATH += "${LAYERDIR}/licenses"

HOSTTOOLS_NONFATAL += "free"
```
